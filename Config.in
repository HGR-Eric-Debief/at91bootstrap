## board/sama5d2_proto888A/sama5d2_proto888A_spi1_uboot_defconfig
```kconfig
CONFIG_SAMA5D2_PROTO888A=y
## SPI bus for Flash memory
CONFIG_SPI=y
CONFIG_SPI_CLK=40000000
CONFIG_SPI_BUS1=y
CONFIG_SPI1_IOSET_3=y
CONFIG_SPI_BOOT_CS0=y

#
# Configured SPI FLash Parameters
#
CONFIG_SET_PARAMS_SPI_FLASH=y
CONFIG_SPI_MAX_FREQ_SLOW_READ=33000000
CONFIG_SPI_FLASH_PARAMS_PAGES=16384
CONFIG_SPI_FLASH_PARAMS_PAGE_SIZE_IS_POWER2=y

CONFIG_DEBUG=y
CONFIG_BEEAVE=y
#
# Memory selection
#
ALLOW_DATAFLASH=y
ALLOW_WITH_MMU=y
ALLOW_WITH_CACHE=y
ALLOW_WITH_DMA=y
ALLOW_KNOWN_RAM_CHIP_DEFINITION=y


CONFIG_DDRC=y
CONFIG_LPDDR1=y
CONFIG_RAM_CHIP_W948D2=y
CONFIG_RAM_32MB=y

# CONFIG_ENTER_NWD is not set
```
