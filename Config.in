## Config.in
```kconfig
mainmenu "AT91 Bootstrap configuration"

config HAVE_DOT_CONFIG
	bool
	default y
	help
	  Indicate that have an included file.

config CONFIG_VERSION
  string "Verion name"
  default "UnknownVersion"
  help
    Set the Bootstrap version name
    
config CONFIG_REVISION
  string "Revision name"
  default "V0"
  help
    Set the Bootstrap revision name

source "board/Config.in"

source "driver/Config.in.driver"

config CONFIG_PROJECT
	string
	default "dataflash"	if CONFIG_DATAFLASH && !CONFIG_UPLOAD_3RD_STAGE && !CONFIG_ONLY_INTERNAL_RAM
	default "flash"		if CONFIG_FLASH && !CONFIG_UPLOAD_3RD_STAGE && !CONFIG_ONLY_INTERNAL_RAM
	default "nandflash"	if CONFIG_NANDFLASH && !CONFIG_UPLOAD_3RD_STAGE && !CONFIG_ONLY_INTERNAL_RAM
	default "sdcard"	if CONFIG_SDCARD && !CONFIG_UPLOAD_3RD_STAGE && !CONFIG_ONLY_INTERNAL_RAM
	default "Upld3rdStage" if CONFIG_UPLOAD_3RD_STAGE && !CONFIG_ONLY_INTERNAL_RAM
	default "internalRAM" if CONFIG_ONLY_INTERNAL_RAM
  

choice 
  prompt "Build Type"
  default CONFIG_BUILD_RELEASE
  
config CONFIG_BUILD_RELEASE
  bool "RELEASE BUILD"
  help
    The build binary will be used 
    only once flashed on to the board.

config CONFIG_BUILD_DEBUG
  bool "DEBUG BUILD"
  help
    The build binary will be used once 
    downloaded through a JTAG probe and then debugged.

endchoice


config CONFIG_DEBUG_3RD_STAGE
  bool "Third Stage (APPLICATION/KERNEL) DEBUG"
  # TEST depends on CONFIG_UPLOAD_3RD_STAGE
  default n
  help
    The bootstrap will wait for a debugger being attached to the board for third stage debug purpose (uploaded with debug probe or read from ROM memory). Then the Program Counter should be manualy set to the application's load address.

config CONFIG_UPLOAD_3RD_STAGE
  bool "Third stage image is uploaded"
  default n
  select CONFIG_DEBUG_3RD_STAGE
  depends on !CONFIG_ONLY_INTERNAL_RAM
  help
    This option will skip the third stage (App, Android or Linux kernel) load operation 
    and go straight to waiting for the debug probe connection.

choice
	prompt "Image Loading Strategy"
	default CONFIG_LOAD_UBOOT 
	depends on !(CONFIG_ONLY_INTERNAL_RAM || CONFIG_UPLOAD_3RD_STAGE)

config CONFIG_LOAD_UBOOT
	bool "Load U-Boot into last MBYTE of SDRAM"
  depends on !CONFIG_SAMA5D31_BEEAVE
	help
	  Use this mode to load an second level boot monitor
	  like U-boot into the last MB of SDRAM.

config CONFIG_LOAD_LINUX
	select CONFIG_LINUX_IMAGE
	bool "Support loading Linux directly"
  depends on !CONFIG_SAMA5D31_BEEAVE
	---help---
	   Load Linux kernel directly from storage media

config CONFIG_LOAD_ANDROID
	select CONFIG_LINUX_IMAGE
	bool "Support loading Android directly"
  depends on !CONFIG_SAMA5D31_BEEAVE
	help
	   Load Android image directly from storage media

config CONFIG_LOAD_1MB
	bool "Load 1 MB into start of SDRAM"
	help
	  Use this mode to load an embedded application
	  which can have a size of up to 1 MByte

config CONFIG_LOAD_4MB
	bool "Load 4 MB into start of SDRAM"
  depends on !CONFIG_SAMA5D31_BEEAVE
	help
	  Use this mode to load an embedded application
	  which can have a size of up to 4 MByte

config CONFIG_LOAD_64KB
	bool "Load 64 kB into the start of SDRAM"
  depends on !CONFIG_SAMA5D31_BEEAVE
	help
	  Use this mode to load an embedded application
	  which can have max 64 kB Size
	  
config CONFIG_LOAD_BEEAVE
  bool "Load the BeeAVE Firmware from the SPI NOR Flash"
  #depends on CONFIG_BEEAVE - TODO : set this flags in BeeAVE module default configuration.
  help
     Use this to set the BeeAVE Firmware download.
  
endchoice

config CONFIG_LINUX_IMAGE
	depends on CONFIG_LOAD_LINUX || CONFIG_LOAD_ANDROID
	bool
	help
	  Select to load linux uImage or zImage to boot

#
# Kernel Image Storage Setup
#
source "Config.in.kernel"

#
# U-Boot Image Storage Setup
#
source "Config.in.u-boot"

#
# Demo App Image Storage Setup
#
source "Config.in.app-image"

#
# BeeAVE Firmware
#
source "Config.in.beeave"

config CONFIG_IMAGE_NAME
	string
	default "Image" if CONFIG_LINUX_IMAGE
	default "u-boot.bin" if CONFIG_LOAD_UBOOT
	default "softpack.bin" if CONFIG_LOAD_64KB || CONFIG_LOAD_4MB || CONFIG_LOAD_1MB
	default "fw.bin" if CONFIG_LOAD_BEEAVE
	help
    the binary file loaded from the persistant memory (SDCARD, NAND or NOR Flash) as the third level bootloader or application

config CONFIG_NO_CONSOLE_OUTPUT
  bool "NO DBGU console output"
  default n
  help
    "No log will be done to the DBGU console"
config CONFIG_DEBUG
	bool "Debug Support"
	default n
	help
	  Output Debug messages
	  
choice
	prompt "Debug Level"
	depends on CONFIG_DEBUG
	
config CONFIG_DEBUG_ERROR
  bool "Error information only"
	
config CONFIG_DEBUG_INFO
	bool "General debug information"

config CONFIG_DEBUG_LOUD
	bool "Loud debug output"

config CONFIG_DEBUG_VERY_LOUD
	bool "Even louder debug output"

endchoice

menu "LED debugging ..."
depends on CONFIG_SAMA5D31_BEEAVE || CONFIG_SAMA5D2_PROTO888A || CONFIG_SAMA5D2_PROTO888B || CONFIG_SAMA5D2_PROTO888C || CONFIG_SAMA5D2_PROD358A || CONFIG_SAMA5D2_PROD358B || CONFIG_SAMA5D2_PROD358D
config CONFIG_BEEAVE_WITH_DEBUG_LEDS
  bool "DEBUG Leds are presents"
  help
    DEBUG Red/Green leds are on the board

choice 
 prompt "DEBUG led init status"
 
config CONFIG_BEEAVE_DEBUG_LEDS_OFF
  bool "OFF"
  
config CONFIG_BEEAVE_DEBUG_LEDS_ON
  bool "ON (Green - Red - Green)"

endchoice
endmenu

menu "FIRMWARE tests ..."
config CONFIG_TEST_FIRMWARE_LOAD_LOOP
  bool "Test firmware load"
  depends on !CONFIG_UPLOAD_3RD_STAGE
  default n
  help
     Will upload the firmware 3 times, then reset and loop over.

config CONFIG_FIRMWARE_LOAD_VALIDATION
  bool "Check the firmware load"
  depends on !CONFIG_UPLOAD_3RD_STAGE
  default n
  help
    Will check that the firmware load is correct in comparing the firmware contents with a known pattern

config CONFIG_FIRMWARE_LOAD_VALIDATION_BYTE
  hex "The expected byte in firmware (in HEX notation)"
  depends on CONFIG_FIRMWARE_LOAD_VALIDATION
  range 0 FF
  help
    The tested firmware area must be loaded with this byte only
endmenu

source "Config.in.secure"

config CONFIG_THUMB
  depends on !( SAMA5D3X || SAMA5D4 || CONFIG_WITH_MMU)
  bool "Build in thumb mode"
  default n
  help
    Build code in thumb mode only if no MMU activated (SAMA5D2 : locked on start up).

config CONFIG_DISABLE_WATCHDOG
	bool "Disable Watchdog"
	default y
	help
	  Disable the watchdog in the boostrap

menu "Hardware Initialization Options"

config CONFIG_HW_DISPLAY_BANNER
	bool "Display Banner"
	default y
	help
	  Display banner

config CONFIG_HW_BANNER
	string Banner
	default "\"\\n\\nAT91Bootstrap \" AT91BOOTSTRAP_VERSION \" (\" COMPILE_TIME \")\\n\\n\""
	depends on CONFIG_HW_DISPLAY_BANNER
	help
	  The banner displayed on serial port

config CONFIG_HW_INIT
	bool "Call Hardware Initialization"
	default y
	help
	  Initialize Hardware

endmenu

menu "Slow Clock Configuration Options"
	depends on CPU_HAS_SCKC

config CONFIG_SCLK
	bool "Use external 32KHZ oscillator as source of slow clock"
	default y
	help
	  Use external 32KHZ oscillator as source of slow clock

config CONFIG_SCLK_BYPASS
	depends on CONFIG_SCLK
	bool "Use external 32kHz clock as source of slow clock"
	default n
	help
	  Use external 32kHz clock as source of slow clock

endmenu

menu "ARM TurstZone Options"
	depends on CPU_HAS_TRUSTZONE

config CONFIG_MATRIX
	bool "Enable Configure the Matrix"
	default y
	help
	  This interface let you to configure the MATRIX0(H64MX) and
	  MATRIX1(H32MX) slave security  and to select the APB slave security startup.

config CONFIG_ENTER_NWD
	select CONFIG_MATRIX
	bool "Enable Enter the Normal World before Jumping"
	default y
	help
	  This interface let you to make the system to enter from the Secure World
	  to the Non-Secure World before the jumping.

config CONFIG_REDIRECT_ALL_INTS_AIC
	bool "Redirect All Peripherals Interrupts to AIC"
	default y
	help
	  This interface let you to redirect all peripherals interrupts to AIC,
	  otherwise, the secure peripherals interrupts direct to SAIC, others to AIC.

endmenu

config CONFIG_PM
	bool "Power Management Options"
	depends on CONFIG_SUPPORT_PM
	default y
	help
	  This interface let you select the external devices on the board to
	  enter the power down mode at startup, such as Audio Codec(wm8904), HDMI(SiI9022ACUN)
	  and ethernet PHY(KSZ8081RNB). Its purpose is to make sure the external devices
	  which will not be touched in the kernel are set the proper power state.

menu "Select the Devices to the Low-power mode"
	depends on CONFIG_PM

config CONFIG_MAC0_PHY
	bool "MAC0 PHYs"
	depends on CONFIG_HAS_EHT0_PHY
	select CONFIG_MACB
	default y
	help
	  This interface allow you to select the MAC0 PHY on the board
	  which will be put into the Power-Down mode.

config CONFIG_MAC1_PHY
	bool "MAC1 PHYs"
	depends on CONFIG_HAS_EHT1_PHY
	select CONFIG_MACB
	default y
	help
	  This interface allow you to select the MAC1 PHY on the board
	  which will be put into the Power-Down mode.

config CONFIG_HDMI
	bool "HDMI (SiI9022)"
	depends on CONFIG_HAS_HDMI
	select CONFIG_TWI
	default y
	help
	  This interface allow you to select the HDMI chip on the board
	  which will be put into the Power-Down mode.

choice
	prompt "HDMI on TWI Select"
	depends on CONFIG_HDMI && !CONFIG_AUTOCONFIG_TWI_BUS
	default CONFIG_HDMI_ON_TWI0
	help
	  This interface allow you select which TWI bus for the HDMI to wire on.

config	CONFIG_HDMI_ON_TWI0
	bool "On TWI0"
	depends on CPU_HAS_TWI0
	select CONFIG_TWI0

config	CONFIG_HDMI_ON_TWI1
	bool "On TWI1"
	depends on CPU_HAS_TWI1
	select CONFIG_TWI1

config	CONFIG_HDMI_ON_TWI2
	bool "On TWI2"
	depends on CPU_HAS_TWI2
	select CONFIG_TWI2

config	CONFIG_HDMI_ON_TWI3
	bool "On TWI3"
	depends on CPU_HAS_TWI3
	select CONFIG_TWI3

endchoice

config CONFIG_WM8904
	bool "Audio CODEC (wm8904)"
	depends on CONFIG_HAS_AUDIO_CODEC
	select CONFIG_TWI
	default y
	help
	  This interface allow you to select the CODEC chip on the board
	  which will be put into the Power-Down mode.

choice
	prompt "CODEC on TWI Select"
	depends on CONFIG_WM8904 && !CONFIG_AUTOCONFIG_TWI_BUS
	default CONFIG_CODEC_ON_TWI0
	help
	  This interface allow you select which TWI bus for the CODEC to wire on.

config	CONFIG_CODEC_ON_TWI0
	bool "On TWI0"
	depends on CPU_HAS_TWI0
	select CONFIG_TWI0

config	CONFIG_CODEC_ON_TWI1
	bool "On TWI1"
	depends on CPU_HAS_TWI1
	select CONFIG_TWI1

config	CONFIG_CODEC_ON_TWI2
	bool "On TWI2"
	depends on CPU_HAS_TWI2
	select CONFIG_TWI2

config	CONFIG_CODEC_ON_TWI3
	bool "On TWI3"
	depends on CPU_HAS_TWI3
	select CONFIG_TWI3

endchoice

config CONFIG_PM_PMIC
	bool "PMIC (ACT8865)"
	depends on CONFIG_HAS_PMIC_ACT8865
	select CONFIG_ACT8865
	default y
	help
	  This interface allow you to select the PMIC(ACT8865) chip on the board
	  which will be set the Power-Saving mode.

endmenu

menu "Board's Workaround Options"
	depends on CONFIG_HAS_PMIC_ACT8865

config CONFIG_DISABLE_ACT8865_I2C
	bool "Disable the ACT8865 I2C interface"
	depends on CONFIG_HAS_PMIC_ACT8865
	select CONFIG_ACT8865
	default y
	help
	  This interface let you to disable the ACT8865's I2C interface.
	  There are some issue about active-semi ACT8865's I2C interface,
	  which affects the other chip which stands on the same I2C bus, such as MXT touchscreen.

endmenu

config CONFIG_ACT8865
	bool "PMIC (ACT8865) Support"
	depends on CONFIG_HAS_PMIC_ACT8865
	select CONFIG_TWI
	default n

choice
	prompt "PMIC (ACT8865) on TWI Select"
	depends on CONFIG_ACT8865 && !CONFIG_AUTOCONFIG_TWI_BUS
	default CONFIG_PMIC_ON_TWI0
	help
	  This interface allow you select which TWI bus for the PMIC to wire on.

config	CONFIG_PMIC_ON_TWI0
	bool "On TWI0"
	depends on CPU_HAS_TWI0
	select CONFIG_TWI0

config	CONFIG_PMIC_ON_TWI1
	bool "On TWI1"
	depends on CPU_HAS_TWI1
	select CONFIG_TWI1

config	CONFIG_PMIC_ON_TWI2
	bool "On TWI2"
	depends on CPU_HAS_TWI2
	select CONFIG_TWI2

config	CONFIG_PMIC_ON_TWI3
	bool "On TWI3"
	depends on CPU_HAS_TWI2
	select CONFIG_TWI3

endchoice

menu "Board Hardware Information Options"
	depends on CONFIG_HAS_HW_INFO

config CONFIG_LOAD_ONE_WIRE
	bool "Load Information from 1-Wire"
	depends on CONFIG_HAS_ONE_WIRE
	select CONFIG_LOAD_HW_INFO
	default y
	help
	  This interface allow you to select hardware information from 1-Wire chips.

config CONFIG_LOAD_EEPROM
	bool "Load Information from EEPROM"
	depends on CONFIG_HAS_EEPROM
	select CONFIG_TWI
	select CONFIG_LOAD_HW_INFO
	default y
	help
	  This interface allow you to select hardware information from EEPROM chips.

choice
	prompt "EEPROM on TWI Select"
	depends on CONFIG_LOAD_EEPROM && !CONFIG_AUTOCONFIG_TWI_BUS
	default CONFIG_EEPROM_ON_TWI0
	help
	  This interface allow you select which TWI bus for the EEPROM to wire on.

config	CONFIG_EEPROM_ON_TWI0
	bool "On TWI0"
	depends on CPU_HAS_TWI0
	select CONFIG_TWI0

config	CONFIG_EEPROM_ON_TWI1
	bool "On TWI1"
	depends on CPU_HAS_TWI1
	select CONFIG_TWI1

config	CONFIG_EEPROM_ON_TWI2
	bool "On TWI2"
	depends on CPU_HAS_TWI2
	select CONFIG_TWI2

config	CONFIG_EEPROM_ON_TWI3
	bool "On TWI3"
	depends on CPU_HAS_TWI3
	select CONFIG_TWI3

endchoice

endmenu

config CONFIG_AUTOCONFIG_TWI_BUS
	bool "Auto Configure TWI Bus by Board"
	depends on CONFIG_TWI
	select CONFIG_TWI0 if CPU_HAS_TWI0
	select CONFIG_TWI1 if CPU_HAS_TWI1
	select CONFIG_TWI2 if CPU_HAS_TWI2
	select CONFIG_TWI3 if CPU_HAS_TWI3
	default y
	help
	  This interface allow the board determines  which TWI bus that
	  the HDMI, Audio CODEC(wm8904), PMIC(ACT8865) is wired on,
	  select automatically, no menuconfig selecting to need.
```

## board/sama5d2_prod358B/sama5d2_prod358B_qspi1_beeave_defconfig
```kconfig
CONFIG_SAMA5D2_PROD358B=y
CONFIG_DEBUG=y
CONFIG_BEEAVE=y
CONFIG_VERSION="BeeAVE"
CONFIG_REVISION="Alpha_6"

## QSPI bus for Flash memory on QSPI1_IOSET2 
CONFIG_QSPI=y
CONFIG_QSPI_CLK=40000000
CONFIG_QSPI_BUS1=y
CONFIG_QSPI1_IOSET_2=y
#Set IO drive to high level : to allow HIGHEST QSPI bus speed
CONFIG_IO_DRVSTR_HIGH=y
#Use the Serial Memory Mode
CONFIG_QSPI_FLASH_SMM=y
#Flash chip in QSPI mode
CONFIG_QSPI_FLASH_CHIP_AT25Sxxx=y
#Use the DMA
CONFIG_QSPI_FLASH_WITH_DMA=y
#
# Configured SPI FLash Parameters
#
CONFIG_SET_PARAMS_SPI_FLASH=y
CONFIG_SPI_MAX_FREQ_SLOW_READ=50000000
CONFIG_SPI_FLASH_PARAMS_PAGES=16384
CONFIG_SPI_FLASH_PARAMS_PAGE_SIZE_IS_POWER2=y
CONFIG_SPI_FLASH_SINGLE_QSPI_MODE=y
#
# Memory selection
#
ALLOW_DATAFLASH=y
ALLOW_WITH_MMU=y
ALLOW_WITH_CACHE=y
ALLOW_WITH_DMA=y
ALLOW_KNOWN_RAM_CHIP_DEFINITION=y

CONFIG_DDRC=y
CONFIG_LPDDR1=y
CONFIG_RAM_CHIP_W948D2=y
CONFIG_RAM_32MB=y

# CONFIG_ENTER_NWD is not set

# Firmware upload
CONFIG_LOAD_BEEAVE=y
CONFIG_IMG_SIZE="900000"
CONFIG_IMG_ADDRESS="0x10000"
CONFIG_JUMP_ADDR="0x20000000"
```

## board/sama5d2_prod358D/sama5d2_prod358D_spi1_beeave_defconfig
```kconfig
CONFIG_SAMA5D2_PROD358D=y
CONFIG_DEBUG=y
CONFIG_BEEAVE=y
CONFIG_VERSION="BeeAVE"
CONFIG_REVISION="Prod_1"


## SPI bus for Flash memory
CONFIG_SPI=y
CONFIG_SPI_CLK=80000000
CONFIG_SPI_BUS1=y
CONFIG_SPI1_IOSET_3=y
CONFIG_SPI_BOOT_CS0=y
#Set IO drive to high level : to allow HIGHEST SPI bus speed
CONFIG_IO_DRVSTR_HIGH=y
#
# Configured SPI FLash Parameters
#
CONFIG_SET_PARAMS_SPI_FLASH=y
CONFIG_SPI_MAX_FREQ_SLOW_READ=50000000
CONFIG_SPI_FLASH_PARAMS_PAGES=16384
CONFIG_SPI_FLASH_PARAMS_PAGE_SIZE_IS_POWER2=y

#
# Memory selection
#
ALLOW_DATAFLASH=y
ALLOW_WITH_MMU=y
ALLOW_WITH_CACHE=y
ALLOW_WITH_DMA=y
ALLOW_KNOWN_RAM_CHIP_DEFINITION=y

CONFIG_DDRC=y
CONFIG_LPDDR1=y
CONFIG_RAM_CHIP_W948D2=y
CONFIG_RAM_32MB=y

# CONFIG_ENTER_NWD is not set

# Firmware upload
CONFIG_LOAD_BEEAVE=y
CONFIG_IMG_SIZE="972800"
CONFIG_IMG_ADDRESS="0x10000"
CONFIG_JUMP_ADDR="0x20000000"
```
